/* Copyright (c) 2013-2014, The Linux Foundation. All rights reserved.
 *
 * This program is free software; you can redistribute it and/or modify
 * it under the terms of the GNU General Public License version 2 and
 * only version 2 as published by the Free Software Foundation.
 *
 * This program is distributed in the hope that it will be useful,
 * but WITHOUT ANY WARRANTY; without even the implied warranty of
 * MERCHANTABILITY or FITNESS FOR A PARTICULAR PURPOSE.  See the
 * GNU General Public License for more details.
 */

&mdss_mdp {
	dsi_jdi_1080_vid: qcom,mdss_dsi_jdi_1080p_video {
		qcom,mdss-dsi-panel-name = "jdi 1080p video mode dsi panel";
		qcom,mdss-dsi-panel-controller = <&mdss_dsi0>;
		qcom,mdss-dsi-panel-type = "dsi_video_mode";
		qcom,mdss-dsi-panel-destination = "display_1";
		qcom,mdss-dsi-panel-framerate = <60>;
		qcom,mdss-dsi-virtual-channel-id = <0>;
		qcom,mdss-dsi-stream = <0>;
		qcom,mdss-dsi-panel-width = <1080>;
		qcom,mdss-dsi-panel-height = <1920>;
		qcom,mdss-dsi-h-front-porch = <96>;
		qcom,mdss-dsi-h-back-porch = <64>;
		qcom,mdss-dsi-h-pulse-width = <16>;
		qcom,mdss-dsi-h-sync-skew = <0>;
		qcom,mdss-dsi-v-back-porch = <16>;
		qcom,mdss-dsi-v-front-porch = <4>;
		qcom,mdss-dsi-v-pulse-width = <1>;
		qcom,mdss-dsi-h-left-border = <0>;
		qcom,mdss-dsi-h-right-border = <0>;
		qcom,mdss-dsi-v-top-border = <0>;
		qcom,mdss-dsi-v-bottom-border = <0>;
		qcom,mdss-dsi-bpp = <24>;
		qcom,mdss-dsi-underflow-color = <0xff>;
		qcom,mdss-dsi-border-color = <0>;
		qcom,mdss-dsi-on-command = [    	   
					23 01 00 00 00 00 02 FF 10
					15 01 00 00 10 00 02 35 00
					15 01 00 00 10 00 02 bb 03
					//29 01 00 00 00 00 03 44 05 00		
					23 01 00 00 00 00 02 FF E0
					23 01 00 00 00 00 02 B5 86
					23 01 00 00 00 00 02 B6 77
					23 01 00 00 00 00 02 B8 AD
					23 01 00 00 00 00 02 FB 01
					23 01 00 00 00 00 02 FF 10

/**************************************************************
					//15 01 00 00 10 00 02 36 03  //add for lcd rotater 180
					self test mode
				    	05 01 00 00 32 00 02 28 00
					05 01 00 00 32 00 02 10 00		  
					23 01 00 00 00 00 02 FF 24
					23 01 00 00 00 00 02 EC 01									  
					23 01 00 00 00 00 02 FF 20
					23 01 00 00 00 00 02 67 4D 
*************************************************************/
					15 01 00 00 10 00 02 36 03  //add for lcd rotater 180					
					23 01 00 00 00 00 02 FF 23
					23 01 00 00 00 00 02 08 03	
					15 01 00 00 00 00 02 FF 10
					15 01 00 00 00 00 02 51 FF
					15 01 00 00 00 00 02 53 24
       
					05 01 00 00 78 00 02 11 00
					05 01 00 00 78 00 02 29 00];
		qcom,mdss-dsi-off-command = [05 01 00 00 02 00 02 28 00
				 05 01 00 00 79 00 02 10 00];
		qcom,mdss-dsi-on-command-state = "dsi_lp_mode";
		qcom,mdss-dsi-off-command-state = "dsi_hs_mode";
		qcom,mdss-dsi-h-sync-pulse = <0>;
		qcom,mdss-dsi-traffic-mode = "burst_mode";
		qcom,mdss-dsi-bllp-eof-power-mode;
		qcom,mdss-dsi-bllp-power-mode;
		qcom,mdss-dsi-lane-0-state;
		qcom,mdss-dsi-lane-1-state;
		qcom,mdss-dsi-lane-2-state;
		qcom,mdss-dsi-lane-3-state;
		qcom,mdss-dsi-panel-timings = [E7 43 37 00 60 6C 39 45 5b 03 04 00];
		qcom,mdss-dsi-t-clk-post = <0x20>;		
		qcom,mdss-dsi-t-clk-pre = <0x3e>;

		qcom,mdss-dsi-bl-min-level = <1>;
		qcom,mdss-dsi-bl-max-level = <4095>;/*guozhiming@oem.cn modify 2015-03-24*/
		qcom,mdss-dsi-lp11-init;
		qcom,mdss-dsi-init-delay-us=<50000>;
		qcom,mdss-dsi-dma-trigger = "trigger_sw";
		qcom,mdss-dsi-mdp-trigger = "none";
		qcom,mdss-dsi-bl-pmic-control-type = "bl_ctrl_wled";
		qcom,mdss-dsi-reset-sequence = <1 10>, <0 10>, <1 50>;
		qcom,mdss-pan-physical-width-dimension = <61>;
		qcom,mdss-pan-physical-height-dimension = <110>;
	};
};

