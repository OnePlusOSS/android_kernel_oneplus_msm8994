/************************************************************
 * Copyright (c) 2013-2013 OPPO Mobile communication Corp.ltd.,
 * VENDOR_EDIT
 * Description: device tree for jdi cmd panel.
 * Version    : 1.0
 * Date       : 2013-12-12
 * Author     : yangxinqin
 *
 * This program is free software; you can redistribute it and/or modify
 * it under the terms of the GNU General Public License version 2 and
 * only version 2 as published by the Free Software Foundation.
 *
 * This program is distributed in the hope that it will be useful,
 * but WITHOUT ANY WARRANTY; without even the implied warranty of
 * MERCHANTABILITY or FITNESS FOR A PARTICULAR PURPOSE.  See the
 * GNU General Public License for more details.
 */

/*---------------------------------------------------------------------------
 * This file is autogenerated file using gcdb parser. Please do not edit it.
 * Update input XML file to add a new entry or update variable in this file
 * VERSION = "1.0"
 *---------------------------------------------------------------------------*/
&mdss_mdp {
dsi_jd35695_1080_cmd: qcom,mdss_dsi_jd35695_1080p_cmd {
			      compatible = "qcom,mdss-dsi-panel";
			      status = "ok";
			      qcom,cont-splash-enabled;
			      qcom,mdss-dsi-panel-name = "jd35695 1080p cmd mode dsi panel";
			      qcom,mdss-dsi-panel-manufacture = "JDI";
			      qcom,mdss-dsi-panel-version = "JD35695";
			      qcom,mdss-dsi-backlight-version= "PMI8994";
			      qcom,mdss-dsi-backlight-manufacture	= "Qualcomm";
			      qcom,mdss-dsi-panel-controller = <&mdss_dsi0>;
			      qcom,mdss-dsi-panel-type = "dsi_cmd_mode";
			      qcom,mdss-dsi-panel-destination = "display_1";
			      qcom,mdss-dsi-panel-framerate = <60>;
			      qcom,mdss-dsi-virtual-channel-id = <0>;
			      qcom,mdss-dsi-stream = <0>;
			      qcom,mdss-dsi-panel-width = <1080>;
			      qcom,mdss-dsi-panel-height = <1920>;
			      qcom,mdss-dsi-h-front-porch = <100>;
			      qcom,mdss-dsi-h-back-porch = <82>;
			      qcom,mdss-dsi-h-pulse-width = <8>;
			      qcom,mdss-dsi-h-sync-skew = <0>;
			      qcom,mdss-dsi-v-back-porch = <7>;
			      qcom,mdss-dsi-v-front-porch = <3>;
			      qcom,mdss-dsi-v-pulse-width = <2>;
			      qcom,mdss-dsi-h-left-border = <0>;
			      qcom,mdss-dsi-h-right-border = <0>;
			      qcom,mdss-dsi-v-top-border = <0>;
			      qcom,mdss-dsi-v-bottom-border = <0>;
			      qcom,mdss-dsi-bpp = <24>;
			      qcom,mdss-dsi-underflow-color = <0x0000ff>;
			      qcom,mdss-dsi-border-color = <0>;
			      qcom,mdss-dsi-on-command = [
				      15 01 00 00 00 00 02 FF 10
				      15 01 00 00 00 00 02 35 00
				      39 01 00 00 00 00 05 2a 00 00 04 37
				      39 01 00 00 00 00 05 2b 00 00 07 7f

				      29 01 00 00 00 00 03 44 05 00
				      15 01 00 00 00 00 02 FF E0
				      15 01 00 00 00 00 02 B5 86
				      15 01 00 00 00 00 02 B6 77
				      15 01 00 00 00 00 02 B8 AD
				      15 01 00 00 00 00 02 FB 01
				      15 01 00 00 00 00 02 FF 10

				      15 01 00 00 00 00 02 36 03  //add for lcd rotater 180
				      15 01 00 00 00 00 02 FF 23
				      15 01 00 00 00 00 02 08 03
				      15 01 00 00 00 00 02 FF 10
				      15 01 00 00 00 00 02 51 FF
				      15 01 00 00 00 00 02 53 2C
				      15 01 00 00 00 00 02 55 02

				      15 01 00 00 00 00 02 FF 23
				      15 01 00 00 00 00 02 FB 01
				      15 01 00 00 00 00 02 05 24
				      15 01 00 00 00 00 02 01 84
				      15 01 00 00 00 00 02 FF 10

				      05 01 00 00 69 00 02 11 00
				      05 01 00 00 2D 00 02 29 00

				      ];
			      qcom,mdss-dsi-off-command = [
				      15 01 00 00 00 00 02 FF 10
				      15 01 00 00 00 00 02 53 00
				      05 01 00 00 64 00 02 28 00
				      05 01 00 00 64 00 02 10 00];

			      qcom,mdss-dsi-color-test-on-command=
				      [
				      05 01 00 00 32 00 02 28 00
				      05 01 00 00 32 00 02 10 00
				      15 01 00 00 00 00 02 FF 24
				      15 01 00 00 00 00 02 EC 01
				      15 01 00 00 00 00 02 FF 20
				      15 01 00 00 00 00 02 67 4D];


			      qcom,mdss-dsi-color-test-off-command =
				      [
				      15 01 00 00 00 00 02 FF 24
				      15 01 00 00 00 00 02 EC 00
				      15 01 00 00 00 00 02 FF 10
				      15 01 00 00 00 00 02 35 00
				      29 01 00 00 00 00 03 44 05 00
				      15 01 00 00 00 00 02 FF 10
				      05 01 00 00 78 00 02 11 00
				      05 01 00 00 32 00 02 29 00];

			      qcom,mdss-dsi-cabc-off-command = [15 01 00 00 10 00 02 55 00
				      05 01 00 00 10 00 02 29 00];
			      qcom,mdss-dsi-cabc-ui-command = [15 01 00 00 10 00 02 55 01
				      05 01 00 00 10 00 02 29 00];
			      qcom,mdss-dsi-cabc-still-image-command = [15 01 00 00 10 00 02 55 02
				      05 01 00 00 10 00 02 29 00];
			      qcom,mdss-dsi-cabc-video-command = [15 01 00 00 10 00 02 55 03
				      05 01 00 00 10 00 02 29 00];

			      qcom,mdss-dsi-on-command_shoushi = [

				      15 01 00 00 00 00 02 36 03  //add for lcd rotater 180
				      15 01 00 00 00 00 02 FF 23
				      15 01 00 00 00 00 02 08 03
				      15 01 00 00 00 00 02 FF 10
				      15 01 00 00 00 00 02 51 FF
				      15 01 00 00 00 00 02 53 2C
				      15 01 00 00 00 00 02 55 02

				      15 01 00 00 00 00 02 FF 23
				      15 01 00 00 00 00 02 FB 01
				      15 01 00 00 00 00 02 05 24
				      15 01 00 00 00 00 02 01 84
				      15 01 00 00 00 00 02 FF 10
				      05 01 00 00 78 00 02 11 00
				      05 01 00 00 60 00 02 29 00

				      ];
			      qcom,mdss-dsi-color-test-on-command-state = "dsi_lp_mode";
			      qcom,mdss-dsi-color-test-off-command-state = "dsi_lp_mode";

			      qcom,mdss-dsi-on-command-state = "dsi_lp_mode";
			      qcom,mdss-dsi-off-command-state = "dsi_hs_mode";
			      qcom,mdss-dsi-h-sync-pulse = <1>;
			      qcom,mdss-dsi-traffic-mode = "burst_mode";
			      qcom,mdss-dsi-lane-map = "lane_map_0123";
			      qcom,mdss-dsi-bllp-eof-power-mode;
			      qcom,mdss-dsi-bllp-power-mode;
			      qcom,mdss-dsi-lane-0-state;
			      qcom,mdss-dsi-lane-1-state;
			      qcom,mdss-dsi-lane-2-state;
			      qcom,mdss-dsi-lane-3-state;
			      qcom,mdss-dsi-panel-timings = [E7 43 37 00 60 6C 39 45 5b 03 04 00];



			      qcom,mdss-dsi-t-clk-post = <0x20>;
			      qcom,mdss-dsi-t-clk-pre = <0x3e>;
			      qcom,mdss-dsi-dma-trigger = "trigger_sw";
			      qcom,mdss-dsi-mdp-trigger = "none";
			      qcom,mdss-dsi-te-pin-select = <1>;
			      qcom,mdss-dsi-wr-mem-start = <0x2c>;
			      qcom,mdss-dsi-wr-mem-continue = <0x3c>;
			      qcom,mdss-dsi-te-dcs-command = <1>;
			      qcom,mdss-dsi-te-check-enable;
			      qcom,mdss-dsi-te-using-te-pin;




			      qcom,mdss-dsi-bl-min-level = <1>;
			      qcom,mdss-dsi-bl-max-level = <4095>;/*guozhiming@oem.cn modify 2015-03-24*/
			      qcom,mdss-dsi-lp11-init;
			      //qcom,mdss-dsi-init-delay-us=<50000>;
			      /**************************************************************************/
			      //	qcom,esd-check-enabled;
			      //    qcom,mdss-dsi-panel-status-command = [06 01 00 01 05 00 02 0A 08];
			      //	qcom,mdss-dsi-panel-status-command-state = "dsi_lp_mode";
			      //	qcom,mdss-dsi-panel-status-check-mode = "reg_read_jd35695";
			      //	qcom,mdss-dsi-panel-status-read-length = <8>;
			      //	qcom,mdss-dsi-panel-max-error-count = <2>;
			      //	qcom,mdss-dsi-panel-status-value = <0x9c 0x00 0x00 0x02 0x40 0x80 0x00 0x00>;
			      /******************************************************************************/
			      //	qcom,mdss-dsi-dma-trigger = "trigger_sw";
			      //	qcom,mdss-dsi-mdp-trigger = "trigger_sw";



			     // qcom,mdss-tear-check-frame-rate=<6000>;
			      //qcom,mdss-tear-check-sync-cfg-height = <1932>; /* Height + VBP + VFP + VSW */
			      //qcom,mdss-tear-check-sync-init-val= <1920>; /* Height */
			      //qcom,mdss-tear-check-sync-threshold-start = <4>;
			      //qcom,mdss-tear-check-sync-threshold-continue = <4>;
			      //qcom,mdss-tear-check-start-pos= <1920>; /* Height */
			      //qcom,mdss-tear-check-rd-ptr-trigger-intr= <1921>; /* Height + 1 */

				  qcom,mdss-pan-physical-width-dimension = <70>;
				 qcom,mdss-pan-physical-height-dimension = <127>;


			      qcom,mdss-dsi-bl-pmic-control-type = "bl_ctrl_wled";
			      qcom,mdss-dsi-reset-sequence = <1 11>, <0 2>, <1 12>;

		      };
};


