## drivers/oem_debug/Kconfig
```kconfig
#add by jiachenghui for support oem trace,2015/05/09

config OEM_TRACE_SUPORT
	default y
	depends on OEM_DEBUG_SUPORT
	bool "OEM debug function, enable it will register the device, which under /dev/otracer."

config OEM_FORCE_DUMP
	default y
	bool "OEM force dump function, it will enable goto the force dump"
```

## drivers/op/Kconfig
```kconfig
#ted_lin@PerfLab add for op gpl helper function support
config OP_GPL_HELPER
	default y
	bool "Oneplus PerfLab herlper, wrapper for exporting GPL SYMBOL"

#ted_lin@PerfLab add for op struct offset helper support
config OP_STRUCT_OFFSET_HELPER
	default y
	bool "Oneplus PerfLab herlper, used for struct member dereference"
```

## fs/exfat/Kconfig
```kconfig
config EXFAT_FS
	tristate
	default y
	select NLS
	select NLS_UTF8
	help
	  If you want to use the exFAT file systems, then you must say Y or M here
	  to inlucde exFAT support.

config EXFAT_VIRTUAL_XATTR
	bool "Virtual xattr support for exFAT filesystem"
	default n
	depends on EXFAT_FS
	help
	  Modification of exFAT filesystem for virtual xattr

config EXFAT_VIRTUAL_XATTR_SELINUX_LABEL
	string "Default string for SELinux label"
	depends on EXFAT_FS && EXFAT_VIRTUAL_XATTR
	default "u:object_r:sdcard_external:s0"
	help
	  Set this to the default string for SELinux label.

config EXFAT_SUPPORT_STLOG
	bool "Enable storage log"
	default y
	depends on EXFAT_FS && PROC_STLOG
```
